
#include "VcanLCDforSTM32.h"

#define VCAN_LCD_H 128
#define VCAN_LCD_W 128

void VcanLCD_GpioInit(void);
void VcanLCD_ResgisterInit(void);
Point GetZeroPoint(void);
Size GetVcanLCDSize(void);
void VcanLCD_GetSize(Size *size);

extern unsigned char const VcanASCII_8x16[1536];

//VcanLcdInfo_t VcanLcdInfo = {VCAN_LCD_W,VCAN_LCD_H,VcanLcdDirection_Default};

#ifdef USE_VCANLCD_STRUCT

VcanLCD_t VcanLCD = 
{
	VcanLCD_Init,
	VcanLCD_ShowMuxString,
	VcanLCD_ShowInt,
	VcanLCD_ShowFloat,
	VcanLCD_Clear,
	VcanLCD_DrawPoint,
	VcanLCD_DrawLine,
	VcanLCD_DrawPenRectangle,
	VcanLCD_DrawRectangleWithColor_t,
	VcanLCD_DrawCircle,
	VcanLCD_DrawBinaryImage,
	VcanLcd_ShowBMP,
	{VCAN_LCD_W,VCAN_LCD_H,VcanLcdDirection_Default}
};

#endif

void VcanLCD_Init(void)
{
		ColorInit();
		VcanLCD_GpioInit();
		VcanLCD_ResgisterInit();
    VcanLCD_DrawRectangleWithColor_t(GetZeroPoint(),GetVcanLCDSize(),BackColor); 
}

void VcanLCD_GpioInit(void)
{
		GPIO_InitTypeDef GPIO_InitStructure;
		RCC_APB2PeriphClockCmd(RCC_APB2Periph_GPIOA | RCC_APB2Periph_GPIOB, ENABLE); 		
		GPIO_InitStructure.GPIO_Mode = GPIO_Mode_Out_PP;		   
		GPIO_InitStructure.GPIO_Speed = GPIO_Speed_50MHz;
		GPIO_InitStructure.GPIO_Pin =  GPIO_Pin_0 | GPIO_Pin_1 |GPIO_Pin_2 |GPIO_Pin_3 |
										GPIO_Pin_8|GPIO_Pin_9|GPIO_Pin_10|GPIO_Pin_11;
		GPIO_Init(VCAN_LCD_P0_GPIO, &GPIO_InitStructure);
	
	  VCAN_LCD_P0_OUT(0x00);
	  
		GPIO_InitStructure.GPIO_Pin =  (1 << VCAN_LCD_WR_PIN) | 
																	 (1 << VCAN_LCD_RD_PIN) |
	                                 (1 << VCAN_LCD_CS_PIN) |
	                                 (1 << VCAN_LCD_RS_PIN) |
	                                 (1 << VCAN_LCD_RST_PIN);
		GPIO_Init(VCAN_LCD_CTL_GPIO, &GPIO_InitStructure);
	
	  VCAN_LCD_WR_OUT = 0;   
    VCAN_LCD_RD_OUT = 1;   
    VCAN_LCD_CS_OUT = 1;    
    VCAN_LCD_RS_OUT  = 0;   
    VCAN_LCD_RST_OUT = 0;   
}

void VcanLCD_ResgisterInit(void)
{
//初始化总线
    VCAN_LCD_RST_OUT = 0;
    VCAN_LCD_DELAY(); 
    VCAN_LCD_RST_OUT = 1;
    VCAN_LCD_DELAY_MS(500);      //上电给足够时间

    VCAN_LCD_WR_8CMD(0x11);           //Sleep out   退出睡眠模式
    VCAN_LCD_DELAY_MS(120);      //Delay 120ms
    //------------------------------------ST7735R Frame Rate-----------------------------------------//
    /* Set the frame frequency of the full Color_ts normal mode. */
    VCAN_LCD_WR_8CMD(0xB1);     //In Normal Mode (Full Color_ts)    全屏模式
    VCAN_LCD_WR_8DATA(0x05);    //设置 RTNA Set 1-line  Period  一行周期
    VCAN_LCD_WR_8DATA(0x3A);    //设置 FPA: Front Porch
    VCAN_LCD_WR_8DATA(0x3A);    //设置 BPA: Back Porch
    //Frame rate=fosc/((RTNA x 2 + 40) x (LINE + FPA + BPA +2))
    //其中 fosc = 850kHz

    /* Set the frame frequency of the Idle mode.  */
    VCAN_LCD_WR_8CMD(0xB2);     //In Idle Mode (8-Color_ts)
    VCAN_LCD_WR_8DATA(0x05);
    VCAN_LCD_WR_8DATA(0x3A);
    VCAN_LCD_WR_8DATA(0x3A);

    /* Set the frame frequency of the Partial mode/ full Color_ts. */
    VCAN_LCD_WR_8CMD(0xB3);
    VCAN_LCD_WR_8DATA(0x05);
    VCAN_LCD_WR_8DATA(0x3A);
    VCAN_LCD_WR_8DATA(0x3A);
    VCAN_LCD_WR_8DATA(0x05);
    VCAN_LCD_WR_8DATA(0x3A);
    VCAN_LCD_WR_8DATA(0x3A);

    //------------------------------------End ST7735R Frame Rate-----------------------------------------//
    VCAN_LCD_WR_8CMD(0xB4);   //Display Inversion Control  显示反转控制

    VCAN_LCD_WR_8DATA(0x07);  //LCD_ST7735R_WR_8DATA(0x03); 原来为3，改为7
    // 低三位从高到低，分别为  full Color_ts normal mode 、Idle mode 、
    // full Color_ts partial mode  的 点反转 或 列反转 ，1为列反转

    VCAN_LCD_WR_8CMD(0xC0);   //Power Control Setting  电源控制设置
    VCAN_LCD_WR_8DATA(0x28);
    VCAN_LCD_WR_8DATA(0x08);
    VCAN_LCD_WR_8DATA(0x84);
    VCAN_LCD_WR_8CMD(0xC1);
    VCAN_LCD_WR_8DATA(0XC0);
    VCAN_LCD_WR_8CMD(0xC2);
    VCAN_LCD_WR_8DATA(0x0C);
    VCAN_LCD_WR_8DATA(0x00);
    VCAN_LCD_WR_8CMD(0xC3);
    VCAN_LCD_WR_8DATA(0x8C);
    VCAN_LCD_WR_8DATA(0x2A);
    VCAN_LCD_WR_8CMD(0xC4);
    VCAN_LCD_WR_8DATA(0x8A);
    VCAN_LCD_WR_8DATA(0xEE);
    //---------------------------------End ST7735R Power Sequence-------------------------------------//
    VCAN_LCD_WR_8CMD(0xC5);   //  VCOM 电压配置
    VCAN_LCD_WR_8DATA(0x0C); //  -0.725
    //------------------------------------ST7735R Gamma Sequence-----------------------------------------//
    VCAN_LCD_WR_8CMD(0xE0);
    VCAN_LCD_WR_8DATA(0x05);
    VCAN_LCD_WR_8DATA(0x1A);
    VCAN_LCD_WR_8DATA(0x0C);
    VCAN_LCD_WR_8DATA(0x0E);
    VCAN_LCD_WR_8DATA(0x3A);
    VCAN_LCD_WR_8DATA(0x34);
    VCAN_LCD_WR_8DATA(0x2D);
    VCAN_LCD_WR_8DATA(0x2F);
    VCAN_LCD_WR_8DATA(0x2D);
    VCAN_LCD_WR_8DATA(0x2A);
    VCAN_LCD_WR_8DATA(0x2F);
    VCAN_LCD_WR_8DATA(0x3C);
    VCAN_LCD_WR_8DATA(0x00);
    VCAN_LCD_WR_8DATA(0x01);
    VCAN_LCD_WR_8DATA(0x02);
    VCAN_LCD_WR_8DATA(0x10);
    VCAN_LCD_WR_8CMD(0xE1);
    VCAN_LCD_WR_8DATA(0x04);
    VCAN_LCD_WR_8DATA(0x1B);
    VCAN_LCD_WR_8DATA(0x0D);
    VCAN_LCD_WR_8DATA(0x0E);
    VCAN_LCD_WR_8DATA(0x2D);
    VCAN_LCD_WR_8DATA(0x29);
    VCAN_LCD_WR_8DATA(0x24);
    VCAN_LCD_WR_8DATA(0x29);
    VCAN_LCD_WR_8DATA(0x28);
    VCAN_LCD_WR_8DATA(0x26);
    VCAN_LCD_WR_8DATA(0x31);
    VCAN_LCD_WR_8DATA(0x3B);
    VCAN_LCD_WR_8DATA(0x00);
    VCAN_LCD_WR_8DATA(0x00);
    VCAN_LCD_WR_8DATA(0x03);
    VCAN_LCD_WR_8DATA(0x12);
    //------------------------------------End ST7735R Gamma Sequence-----------------------------------------//

    VCAN_LCD_WR_8CMD(0x3A); //65k mode
    VCAN_LCD_WR_8DATA(0x05);
    VCAN_LCD_WR_8CMD(0x29); //开显示 Display on
    VCAN_LCD_WR_8CMD(0x2c); //

    VcanLCD_SetShowDirection(VcanLcdDirection_Default);
}

void VcanLCD_SetShowDirection(VcanLcdDirection_t option)
{
	VcanLCD.Info.ShowDirection  = option;
    switch(option)
    {
    case 0:
        VCAN_LCD_WR_8CMD(0x36); // 内存数据访问控制  MX 列地址顺序, MY 行地址顺序 ，MV 行列交换 ，ML 垂直刷新顺序 ,RGB  RGB-BGA顺序
        VCAN_LCD_WR_8DATA(0xc8);//0xc8  0xA8 0x08 0x68

        VCAN_LCD_WR_8CMD(0x2a);
        VCAN_LCD_WR_8DATA(0x00);
        VCAN_LCD_WR_8DATA(0x00);
        VCAN_LCD_WR_8DATA(0x00);
        VCAN_LCD_WR_8DATA(128);

        VCAN_LCD_WR_8CMD(0x2B);
        VCAN_LCD_WR_8DATA(0x00);
        VCAN_LCD_WR_8DATA(50);
        VCAN_LCD_WR_8DATA(0x00);
        VCAN_LCD_WR_8DATA(128+50);

        VcanLCD.Info.ShowHeight = VCAN_LCD_H;
        VcanLCD.Info.ShowWidth  = VCAN_LCD_W;
			//	VcanLcdInfo.ShowDirection = VcanLcdDirection_Default;
        break;
    case 1:
        VCAN_LCD_WR_8CMD(0x36); // 内存数据访问控制  MX 列地址顺序, MY 行地址顺序 ，MV 行列交换 ，ML 垂直刷新顺序 ,RGB  RGB-BGA顺序
        VCAN_LCD_WR_8DATA(0xA8);//0xc8  0xA8 0x08 0x68

        VCAN_LCD_WR_8CMD(0x2a);
        VCAN_LCD_WR_8DATA(0x00);
        VCAN_LCD_WR_8DATA(0x03);
        VCAN_LCD_WR_8DATA(0x00);
        VCAN_LCD_WR_8DATA(0x82);

        VCAN_LCD_WR_8CMD(0x2B);
        VCAN_LCD_WR_8DATA(0x00);
        VCAN_LCD_WR_8DATA(0x02);
        VCAN_LCD_WR_8DATA(0x00);
        VCAN_LCD_WR_8DATA(0x81);

        VcanLCD.Info.ShowHeight = VCAN_LCD_W;
        VcanLCD.Info.ShowWidth  = VCAN_LCD_H;
			//	VcanLcdInfo.ShowDirection = VcanLcdDirection_Rotate90;
        break;
    case 2:
        VCAN_LCD_WR_8CMD(0x36); // 内存数据访问控制  MX 列地址顺序, MY 行地址顺序 ，MV 行列交换 ，ML 垂直刷新顺序 ,RGB  RGB-BGA顺序
        VCAN_LCD_WR_8DATA(0x08);//0xc8  0xA8 0x08 0x68

        VCAN_LCD_WR_8CMD(0x2a);
        VCAN_LCD_WR_8DATA(0x00);
        VCAN_LCD_WR_8DATA(0x02);
        VCAN_LCD_WR_8DATA(0x00);
        VCAN_LCD_WR_8DATA(0x81);

        VCAN_LCD_WR_8CMD(0x2B);
        VCAN_LCD_WR_8DATA(0x00);
        VCAN_LCD_WR_8DATA(0x03);
        VCAN_LCD_WR_8DATA(0x00);
        VCAN_LCD_WR_8DATA(0x82);

        VcanLCD.Info.ShowHeight = VCAN_LCD_H;
        VcanLCD.Info.ShowWidth  = VCAN_LCD_W;
					//	VcanLcdInfo.ShowDirection = VcanLcdDirection_Rotate180;
        break;
    case 3:
        VCAN_LCD_WR_8CMD(0x36); // 内存数据访问控制  MX 列地址顺序, MY 行地址顺序 ，MV 行列交换 ，ML 垂直刷新顺序 ,RGB  RGB-BGA顺序
        VCAN_LCD_WR_8DATA(0x68);//0xc8  0xA8 0x08 0x68

        VCAN_LCD_WR_8CMD(0x2a);
        VCAN_LCD_WR_8DATA(0x00);
        VCAN_LCD_WR_8DATA(0x03);
        VCAN_LCD_WR_8DATA(0x00);
        VCAN_LCD_WR_8DATA(0x82);

        VCAN_LCD_WR_8CMD(0x2B);
        VCAN_LCD_WR_8DATA(0x00);
        VCAN_LCD_WR_8DATA(0x00);
        VCAN_LCD_WR_8DATA(0x00);
        VCAN_LCD_WR_8DATA(128);

       VcanLCD.Info.ShowWidth = VCAN_LCD_W;
        VcanLCD.Info.ShowWidth = VCAN_LCD_H;
					//	VcanLcdInfo.ShowDirection = VcanLcdDirection_Rotate270;
        break;
    default:
        break;
    }

}

void VcanLCD_Ptlon(Point site, Size size)
{

    if(VcanLCD.Info.ShowDirection&0x01)
        site.X += 32;     
    else
        site.Y += 32;
    VCAN_LCD_WR_8CMD(0x2a);   //Partial Mode On  局部模式
    VCAN_LCD_WR_8DATA((uint8)(site.X >> 8)); //高8位 Sx
    VCAN_LCD_WR_8DATA((uint8)site.X);   //低8位 Sx
    VCAN_LCD_WR_8DATA((uint8)((site.X + size.Width - 1) >> 8));
    VCAN_LCD_WR_8DATA((uint8)(site.X + size.Width - 1));

    VCAN_LCD_WR_8CMD(0x2B);//Row Address Set  行地址设置
    VCAN_LCD_WR_8DATA((uint8)(site.Y >> 8));
    VCAN_LCD_WR_8DATA((uint8)site.Y);
    VCAN_LCD_WR_8DATA((uint8)((site.Y + size.Height - 1) >> 8));
    VCAN_LCD_WR_8DATA((uint8)(site.Y + size.Height - 1));

}

//以下是用户函数

Point GetZeroPoint(void)
{
	Point point = {0,0};
	return point;
}

Point NewPoint(int x,int y)
{
	Point point; 
	point.X = x;point.Y = y;
	return point;
}

Size NewSize(int width,int height)
{
	Size size;
  size.Width = width;size.Height = height;
	return size;
}

Point NewPointFromSize(Point site,Size size)
{
	Point point; 
	point.X = site.X + size.Width - 1;
	point.Y = site.Y + size.Height - 1;
	return point;
}

void VcanLCD_GetSize(Size *size)
{
    size->Height = VcanLCD.Info.ShowHeight;               //高
    size->Width = VcanLCD.Info.ShowWidth;                 //宽
}

Size GetVcanLCDSize(void)
{
		Size size;
		size.Width = VcanLCD.Info.ShowWidth;
		size.Height = VcanLCD.Info.ShowHeight;
	return size;
}

void VcanLCD_Clear(uint16 rgb565)     //清屏
{
    Point site = {0,0};
    Size size;
		VcanLCD_GetSize(&size);
    VcanLCD_DrawRectangle(site, size, rgb565);
}

void VcanLCD_DrawPoint(Point site, uint16 rgb565)
{
    Size size = {1, 1};
    VcanLCD_Ptlon(site, size);
    VCAN_LCD_RAMWR();                        //写内存
    VCAN_LCD_WR_DATA(rgb565);                //写数据
}

void VcanLCD_DrawPointXY(int x,int y,uint16 rgb565)
{
    Size size = {1, 1};
		Point point;point.X = x;point.Y = y;
    VcanLCD_Ptlon(point, size);
    VCAN_LCD_RAMWR();                        //写内存
    VCAN_LCD_WR_DATA(rgb565);                //写数据
}

void VcanLCD_DrawLine(Point site,unsigned char lenth,Color_t Color_t,VcanLcdAround_t around)
{
		unsigned char i = 0;
		switch(around)
		{
			case VcanLcdAround_Right:	
				VcanLCD_Ptlon(site, NewSize(UP_RANGE(site.X + lenth - 1,\
					VcanLCD.Info.ShowWidth),1));
				break;
			case VcanLcdAround_Down:
				VcanLCD_Ptlon(site,NewSize(1,UP_RANGE(site.Y + lenth - 1,\
					VcanLCD.Info.ShowHeight)));
				break;
			case VcanLcdAround_Left:
				VcanLCD_Ptlon(NewPoint(DOWM_RANGE(site.X - lenth + 1,0),site.Y), \
					NewSize(lenth,1));
				break;
			case VcanLcdAround_Up:
				VcanLCD_Ptlon(NewPoint(site.X,DOWM_RANGE(site.Y - lenth + 1,0)), \
					NewSize(1,lenth));
				break;
			default:
				return;
		}
    VCAN_LCD_RAMWR();                        //写内存
		for(;i< lenth;++i)
			VCAN_LCD_WR_DATA(Color_t.RBG565Value);     //写数据
}

void VcanLCD_DrawPenRectangle(Point site,Size size,Color_t Color_t)
{
		Point point = NewPointFromSize(site,size);
		VcanLCD_DrawLine(site,size.Width, Color_t,VcanLcdAround_Right);
		VcanLCD_DrawLine(site,size.Height,Color_t,VcanLcdAround_Down);
		VcanLCD_DrawLine(point,size.Width,Color_t,VcanLcdAround_Left);
		VcanLCD_DrawLine(point,size.Height,Color_t,VcanLcdAround_Up);
}

void VcanLCD_DrawRectangle(Point site, Size size, uint16 rgb565)
{
    uint32 n, temp;

    VcanLCD_Ptlon(site, size);              //开窗

    temp = (uint32)size.Width * size.Height;
    VCAN_LCD_RAMWR();                        //写内存
    for(n = 0; n < temp; n++)
    {
        VCAN_LCD_WR_DATA( rgb565 );          //写数据
    }
}

void VcanLCD_DrawRectangleWithColor_t(Point site, Size size, Color_t Color_t)
{
		VcanLCD_DrawRectangle(site,size,Color_t.RBG565Value);
}

void VcanLCD_DrawCircle(uint16 x0,uint16 y0,uint8 r,Color_t Color_t)
{
	int a,b;
	int di;
	a=0;b=r;	  
	di=3-(r<<1);             //判断下个点位置的标志
	while(a<=b)
	{
		VcanLCD_DrawPointXY(x0-b,y0-a,Color_t.RBG565Value);             //3           
		VcanLCD_DrawPointXY(x0+b,y0-a,Color_t.RBG565Value);             //0           
		VcanLCD_DrawPointXY(x0-a,y0+b,Color_t.RBG565Value);             //1       
		VcanLCD_DrawPointXY(x0-b,y0-a,Color_t.RBG565Value);             //7           
		VcanLCD_DrawPointXY(x0-a,y0-b,Color_t.RBG565Value);             //2             
		VcanLCD_DrawPointXY(x0+b,y0+a,Color_t.RBG565Value);             //4               
		VcanLCD_DrawPointXY(x0+a,y0-b,Color_t.RBG565Value);             //5
		VcanLCD_DrawPointXY(x0+a,y0+b,Color_t.RBG565Value);             //6 
		VcanLCD_DrawPointXY(x0-b,y0+a,Color_t.RBG565Value);             
		a++;
		//使用Bresenham算法画圆     
		if(di<0)di +=4*a+6;	  
		else
		{
			di+=10+4*(a-b);   
			b--;
		} 
		VcanLCD_DrawPointXY(x0+a,y0+b,Color_t.RBG565Value);
	}
}		

void VcanLCD_DrawBinaryImageWithColor_t(Point site, Size size, uint8 *img,uint16 OneColor_tVal,uint16 ZeroColor_tVal)
{
		uint32     total = (size.Height * size.Width) / 8;
    uint8     imgtemp;
    uint8       bitindex;
    uint8     *pimg = (uint8 *)img;

    VcanLCD_Ptlon(site, size);
    VCAN_LCD_RAMWR();  

    while(total--)
    {
        imgtemp     = *(pimg++);
        bitindex    = 8;
        while(bitindex--)
        {
            if( imgtemp & (0x01 << bitindex) )
            {
                VCAN_LCD_WR_DATA( OneColor_tVal );      //写图像数据
            }
            else
            {
                VCAN_LCD_WR_DATA(  ZeroColor_tVal  );      //写图像数据
            }
        }
    }
}

void VcanLCD_DrawGrayImage(Point site, Size size, uint8 *img)
{
		VcanLCD_DrawBinaryImageWithColor_t(site,size,img, \
			Color.White.RBG565Value,Color.Black.RBG565Value);
}

void VcanLCD_DrawBinaryImage(Point site, Size size, uint8 *img)
{
    uint32     total = (size.Height * size.Width) / 8;
    uint8     imgtemp;
    uint8       bitindex;
    uint8     *pimg = (uint8 *)img;

    VcanLCD_Ptlon(site, size);
    VCAN_LCD_RAMWR();  

    while(total--)
    {
        imgtemp     = *(pimg++);
        bitindex    = 8;
        while(bitindex--)
        {
            if( imgtemp & (0x01 << bitindex) )
            {
                VCAN_LCD_WR_DATA( 0X0000 );      //写图像数据
            }
            else
            {
                VCAN_LCD_WR_DATA(  0Xffff  );      //写图像数据
            }
        }
    }
}

void MyRowDrawBMP(Point site, Size size, uint8 *img)
{
		int x;
		Size sizeTemp = NewSize(8,128);		
		for(x = 7; x >= 0 ;--x)
		{
				VcanLCD_DrawBinaryImage(NewPoint(x*8,0),sizeTemp,img + ( 7 - x)*128);
		}
}

//以下是画字符的函数
void VcanLCD_ShowChar(Point site, uint8 ascii, uint16 Color_t, uint16 bkColor_t)
{
#define MAX_CHAR_POSX (VcanLCD.Info.ShowWidth-8)
#define MAX_CHAR_POSY (VcanLCD.Info.ShowHeight-16)

    uint8 temp, t, pos;
    Size size = {8, 16};

    if(site.X > MAX_CHAR_POSX || site.Y > MAX_CHAR_POSY)
    {
        return;
    }

    VcanLCD_Ptlon(site, size);
    VCAN_LCD_RAMWR();  

    for (pos = 0; pos < 16; pos++)
    {
        temp = VcanASCII_8x16[((ascii-0x20)*16)+pos];

        for(t = 0; t < 8; t++)
        {

            if(temp & 0x80)
            {
                VCAN_LCD_WR_DATA(Color_t);
            }
            else
            {
                VCAN_LCD_WR_DATA(bkColor_t);
            }
            temp <<= 1;
        }
    }
    return;
#undef MAX_CHAR_POSX
#undef MAX_CHAR_POSY
}

void VcanLCD_ShowString(unsigned char x,unsigned char y,char * str)
{
		VcanLCD_DrawString(NewPoint(x,y*16),str,\
			StringColor,BackColor);
}

void VcanLCD_ShowInt(unsigned char x,unsigned char y,int val,TextAlign_t align)
{	
		char str[NumTextShowBit] = "";
		char str_geshi[3] = "";str_geshi[0] = '%';
		str_geshi[1] = '0' + NumTextShowBit;str_geshi[2] = 'd';
		sprintf(str,str_geshi,val);
		if(align == TextAlign_Left)
				CStringAlignToLeft(str);	
		VcanLCD_DrawString(NewPoint(x,y*16),str,\
				StringColor,BackColor);
}

void VcanLCD_ShowFloat(unsigned char x,unsigned char y,float val,TextAlign_t align)
{	
		char str[8] = "";
		sprintf(str,"%8.2f",val);
		if(align == TextAlign_Left)
				CStringAlignToLeft(str);	
		VcanLCD_DrawString(NewPoint(x,y*16),str,\
				StringColor,BackColor);
}

void VcanLCD_DrawString(Point site, int8 *Str, Color_t strColor_t, Color_t bkColor_t)
{
#define MAX_CHAR_POSX (VcanLCD.Info.ShowWidth-8)
#define MAX_CHAR_POSY (VcanLCD.Info.ShowHeight-16)
    while(*Str != '\0')
    {
        if(site.X > MAX_CHAR_POSX )
        {
            //换行
            site.X = 0;
            site.Y += 16;
        }
        if(site.Y > MAX_CHAR_POSY )
        {
            //一屏
            site.Y = 0;
            site.X = 0;
        }

        VcanLCD_ShowChar(site, *Str, strColor_t.RBG565Value, bkColor_t.RBG565Value);
        site.X += 8;
        Str ++ ;
    }
#undef MAX_CHAR_POSX
#undef MAX_CHAR_POSY
}

void VcanLCD_DrawChineseString(Point site, int8 *Str, uint16 strColor_t, uint16 bkColor_t)
{
#define MAX_CHAR_POSX (VcanLCD.Info.ShowWidth-8)
#define MAX_CHAR_POSY (VcanLCD.Info.ShowHeight-16)				 
//    Size size = {8, 16};
		Size HZsize = {16, 16};
		int index = 0;
    while(*Str != '\0')
    {
        if(site.X > MAX_CHAR_POSX )
        {
            //换行
            site.X = 0;
            site.Y += 16;
        }
        if(site.Y > MAX_CHAR_POSY )
        {
            //一屏
            site.Y = 0;
            site.X = 0;
        }
				if(*Str > 127)
				{	
					uint8_t page , column;
					uint8_t buffer[32];		
					uint16_t tmp_char=0;
					if(site.X > MAX_CHAR_POSX || site.Y > MAX_CHAR_POSY)
					{
						return;
					}
					GetGBKCodeFromSD(buffer,(const unsigned char *)Str);
					VcanLCD_Ptlon(site, HZsize);
					VCAN_LCD_RAMWR(); 
					for(page=0; page< 16; page++)
					{
						tmp_char=buffer[page*2];
						tmp_char=(tmp_char<<8);
						tmp_char|=buffer[2*page+1];
		
						for (column=0; column< 16; column++)
						{			
							if ( tmp_char & (0x01<<15) )
							{				
									VCAN_LCD_WR_DATA(strColor_t);
							}
							else
							{			
									VCAN_LCD_WR_DATA(bkColor_t);
							}
							tmp_char <<= 1;
						}
					}	
					index ++;
					site.X += 8;
					Str ++ ;
				}
				else
					VcanLCD_ShowChar(site, *Str, strColor_t, bkColor_t);
        site.X += 8;
        Str ++ ;
	
    }
#undef MAX_CHAR_POSX
#undef MAX_CHAR_POSY
}

void VcanLCD_ShowChineseString(int x,int y, int8 *Str)
{
			VcanLCD_DrawChineseString(NewPoint(x,y*16),Str,\
					StringColor.RBG565Value,BackColor.RBG565Value);
}


void VcanLCD_num_BC(Point site, uint32 num, uint8 max_num_bit, uint16 Color_t, uint16 bkColor_t)
{
    uint32 res = num;
    uint8 t = 0;
    Point sitetemp;
    Size size;

    sitetemp.Y = site.Y;

    if( num == 0 )
    {
        VcanLCD_ShowChar(site, '0', Color_t, bkColor_t);

        site.X += 8;
        size.Height  = 16;
        size.Width  = 8 * (max_num_bit - 1);
        VcanLCD_DrawRectangle(site, size, bkColor_t);

        return;
    }
    while( res )            /*得到数字长度t*/
    {
        res /= 10;
        t++;
    }
    if(t >= max_num_bit )    //限制最大长度
    {
        t = max_num_bit;
    }

    res = t;

    while( t != 0 )
    {
        sitetemp.X = site.X + (8 * (t--) - 8);
        VcanLCD_ShowChar(sitetemp, (num % 10) + '0', Color_t, bkColor_t);
        num /= 10 ;
    }

    if(res != max_num_bit )
    {
        size.Width = 8 * (max_num_bit - res);
        site.X += (8 * res);
        size.Height  = 16;
        VcanLCD_DrawRectangle(site, size, bkColor_t);
    }
}


unsigned char const VcanASCII_8x16[1536] =  //96X16=1536      //ascii字符范围为[32,127] = 96个字符,每个字符要用16个字节来表示  所以有96X16=1536个字节
{
    0x00, 0x00, 0x00, 0x00, 0x00, 0x00, 0x00, 0x00, 0x00, 0x00, 0x00, 0x00, 0x00, 0x00, 0x00, 0x00,
    0x00, 0x00, 0x18, 0x3C, 0x3C, 0x3C, 0x18, 0x18, 0x18, 0x00, 0x18, 0x18, 0x00, 0x00, 0x00, 0x00,
    0x00, 0x66, 0x66, 0x66, 0x24, 0x00, 0x00, 0x00, 0x00, 0x00, 0x00, 0x00, 0x00, 0x00, 0x00, 0x00,
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    0x00, 0x00, 0x00, 0x00, 0x10, 0x38, 0x6C, 0xC6, 0xC6, 0xC6, 0xFE, 0x00, 0x00, 0x00, 0x00, 0x00
};







